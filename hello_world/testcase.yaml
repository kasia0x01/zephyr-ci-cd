## hello_world/testcase.yaml
```yaml
tests:
  sample.hello_world:
    timeout: 10
    tags: introduction
    platform_allow: qemu_cortex_m3
    harness: console
    harness_config:
      type: one_line
      regex:
        - "Popped 5 elements"
```

## tests/ring_buffer/testcase.yaml
```yaml
tests:
  ring_buffer.unit:
    tags: ring_buffer unit
    platform_allow: native_sim
```
